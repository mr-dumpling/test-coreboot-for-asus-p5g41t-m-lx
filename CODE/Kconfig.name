## Kconfig
```kconfig
#
# This file is part of the coreboot project.
#
# Copyright (C) 2015 Damien Zammit <damien@zamaudio.com>
# Copyright (C) 2016 Renze Nicolai <renze@rnplus.nl>
#
# This program is free software; you can redistribute it and/or modify
# it under the terms of the GNU General Public License as published by
# the Free Software Foundation; version 2 of the License.
#
# This program is distributed in the hope that it will be useful,
# but WITHOUT ANY WARRANTY; without even the implied warranty of
# MERCHANTABILITY or FITNESS FOR A PARTICULAR PURPOSE.  See the
# GNU General Public License for more details.
#

if BOARD_ASUS_P5G41T_M_LX

config BOARD_SPECIFIC_OPTIONS
	def_bool y
	select ARCH_X86
	select CPU_INTEL_SOCKET_LGA775
	select NORTHBRIDGE_INTEL_X4X
	select SOUTHBRIDGE_INTEL_I82801GX
	select SUPERIO_WINBOND_W83627DHG
	select HAVE_ACPI_TABLES
	select BOARD_ROMSIZE_KB_1024
	select INTEL_EDID
	select MAINBOARD_HAS_NATIVE_VGA_INIT

config MMCONF_BASE_ADDRESS
	hex
	default 0xe0000000

config MAINBOARD_DIR
	string
	default "asus/p5g41t-m_lx"

config MAINBOARD_PART_NUMBER
	string
	default "P5G41T-M_LX"

endif # BOARD_ASUS_P5G41T_M_LX
```
